## day07/firmware/sdkconfig.defaults
```kconfig
CONFIG_IDF_TARGET="esp32s3"
# 画面と API で 11 個のハンドラを登録する
CONFIG_HTTPD_MAX_URI_LEN=128
CONFIG_HTTPD_MAX_REQ_HDR_LEN=2048
```

## day14/door_sensor/sdkconfig.defaults
```kconfig
# ESPr Developer S3 Type-C（ESP32-S3-WROOM-1-N16R8、フラッシュ 16MB）用
CONFIG_IDF_TARGET="esp32s3"
CONFIG_ESPTOOLPY_FLASHSIZE_16MB=y
CONFIG_ESPTOOLPY_FLASHSIZE="16MB"
# 旧タッチドライバの非推奨の警告を出さない
CONFIG_TOUCH_SUPPRESS_DEPRECATE_WARN=y
```

## day14/door_sensor_original_esp32/sdkconfig.defaults
```kconfig
# ESP32-DevKitC（ESP32-WROOM-32、フラッシュ 4MB）用
CONFIG_IDF_TARGET="esp32"
CONFIG_ESPTOOLPY_FLASHSIZE_4MB=y
CONFIG_ESPTOOLPY_FLASHSIZE="4MB"
# 旧タッチドライバの非推奨の警告を出さない
CONFIG_TOUCH_SUPPRESS_DEPRECATE_WARN=y
```
